## a7/meta-safety-monitor/conf/layer.conf
```bitbake
BBPATH .= ":${LAYERDIR}"
BBFILES += "${LAYERDIR}/recipes-*/*/*.bb \
            ${LAYERDIR}/recipes-*/*/*.bbappend"

BBFILE_COLLECTIONS += "safety-monitor"
BBFILE_PATTERN_safety-monitor = "^${LAYERDIR}/"
BBFILE_PRIORITY_safety-monitor = "10"

LAYERDEPENDS_safety-monitor = "core openembedded-layer"
LAYERSERIES_COMPAT_safety-monitor = "scarthgap"
```
